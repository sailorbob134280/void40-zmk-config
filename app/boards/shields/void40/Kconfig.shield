## app/boards/shields/void40/Kconfig.shield
```kconfig
# Copyright (c) 2021 The ZMK Contributors
# SPDX-License-Identifier: MIT

config SHIELD_VOID40
    def_bool $(shields_list_contains,void40)
```

## config/boards/shields/void40/Kconfig.defconfig
```kconfig
# Copyright (c) 2021 The ZMK Contributors
# SPDX-License-Identifier: MIT

if SHIELD_VOID40

config ZMK_KEYBOARD_NAME
    default "VOID40"

endif
```
